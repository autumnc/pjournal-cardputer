## sdkconfig.defaults
```kconfig
# ESP-IDF PJOURNAL - Minimal Configuration
CONFIG_IDF_TARGET="esp32s3"
CONFIG_ESPTOOLPY_FLASHMODE_QIO=y
CONFIG_ESPTOOLPY_FLASHSIZE_8MB=y
CONFIG_PARTITION_TABLE_CUSTOM=y

# CPU
CONFIG_ESP_DEFAULT_CPU_FREQ_MHZ_240=y

# WiFi
CONFIG_ESP_WIFI_STATIC_RX_BUFFER_NUM=6
CONFIG_ESP_WIFI_DYNAMIC_RX_BUFFER_NUM=12
CONFIG_LWIP_TCPIP_RECVMBOX_SIZE=16
CONFIG_LWIP_UDP_RECVMBOX_SIZE=16
CONFIG_MBEDTLS_DYNAMIC_FREE_CONFIG_DATA=y

# Cache
CONFIG_ESP32S3_INSTRUCTION_CACHE_32KB=y
CONFIG_ESP32S3_DATA_CACHE_LINE_64B=y

# FreeRTOS
CONFIG_FREERTOS_HZ=1000

# SPIFFS
CONFIG_SPIFFS_USE_MTIME=y

# HTTP
CONFIG_HTTPD_MAX_REQ_HDR_LEN=512

# FATFS
CONFIG_FATFS_LFN_HEAP=y

# TinyUSB MSC (USB drive mode)
CONFIG_TINYUSB_MSC_ENABLED=y

# Console
CONFIG_ESP_CONSOLE_UART_DEFAULT=y

# Main task stack (needed for HTTPS/TLS in flomo operations)
CONFIG_ESP_MAIN_TASK_STACK_SIZE=12288
```
